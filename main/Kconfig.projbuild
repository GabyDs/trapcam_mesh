## main/Kconfig.projbuild
```kconfig
menu "Mesh Configuration"

config ROUTER_SSID
    string "Router SSID"
        default "ROUTER_SSID"
        help
            SSID of the WiFi router to connect to.
            This router provides internet access to the root node.

config ROUTER_PASSWORD
    string "Router password"
        default "ROUTER_PASSWORD"
        help
            Password of the WiFi router.

config MESH_ROOT
    bool "Configure this device as root node"
    default n
    help
        If enabled, this device will ONLY operate as root node (level 1).
        It will connect directly to the router and cannot be a child node.
        The root node NEVER enters deep sleep - it maintains the mesh 24/7.
        
        If disabled, this device CANNOT become root node.
        It will wait for a root node to be available and connect as a child.
        Leaf nodes use ULP co-processor for ultra-low power PIR monitoring.
        
        This ensures only one designated device can be root in the mesh network.

menu "Leaf Node Configuration"
    depends on !MESH_ROOT

config LEAF_PIR_GPIO
    int "PIR Sensor GPIO pin"
    default 12
    range 0 39
    help
        GPIO pin connected to the PIR motion sensor.
        Must be an RTC-capable GPIO for ULP access.
        Default: GPIO12 (RTC_GPIO15)

config LEAF_AWAKE_TIME_MS
    int "Time to stay awake after motion (ms)"
    default 30000
    range 5000 300000
    help
        How long the leaf node stays awake after detecting motion.
        During this time it connects to mesh and processes the event.
        Default: 30000 (30 seconds)

config LEAF_ULP_POLL_PERIOD_US
    int "ULP PIR polling period (microseconds)"
    default 100000
    range 10000 1000000
    help
        How often the ULP co-processor checks the PIR sensor.
        Lower values = faster detection but higher power consumption.
        Default: 100000 (100ms = 10 checks per second)

endmenu

endmenu
```
